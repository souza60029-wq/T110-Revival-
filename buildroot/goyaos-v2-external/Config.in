## buildroot/goyaos-v2-external/Config.in
```kconfig
menu "GoyaOS V2 packages"

source "$BR2_EXTERNAL_GOYAOS_V2_PATH/package/lvgl/Config.in"
source "$BR2_EXTERNAL_GOYAOS_V2_PATH/package/goya-shell/Config.in"

endmenu
```

## buildroot/goyaos-v2-external/configs/goyaos_v2_defconfig
```kconfig
BR2_arm=y
BR2_cortex_a9=y
BR2_ARM_ENABLE_NEON=y
BR2_ARM_ENABLE_VFP=y
BR2_ARM_FPU_NEON=y
BR2_ARM_EABIHF=y
BR2_TOOLCHAIN_BUILDROOT_MUSL=y
BR2_TARGET_GENERIC_HOSTNAME="goyaos-t110"
BR2_TARGET_GENERIC_GETTY_PORT="ttyS1"
BR2_ROOTFS_OVERLAY="$(BR2_EXTERNAL_GOYAOS_V2_PATH)/board/t110/rootfs-overlay"
BR2_ROOTFS_POST_BUILD_SCRIPT="$(BR2_EXTERNAL_GOYAOS_V2_PATH)/board/t110/post-build.sh"
BR2_GLOBAL_PATCH_DIR="$(BR2_EXTERNAL_GOYAOS_V2_PATH)/patches"
BR2_TARGET_ROOTFS_TAR=y
BR2_LINUX_KERNEL=y
BR2_LINUX_KERNEL_CUSTOM_GIT=y
BR2_LINUX_KERNEL_CUSTOM_REPO_URL="https://github.com/souza60029-wq/T110-Revival-.git"
BR2_LINUX_KERNEL_CUSTOM_REPO_VERSION="473b5fbe34cd2d56f5f52dabba0db9280e8c49ba"
BR2_LINUX_KERNEL_CUSTOM_REPO_SUBDIR="kernel/src"
BR2_LINUX_KERNEL_DEFCONFIG="pxa986_goyawifi_rev02"
BR2_LINUX_KERNEL_CONFIG_FRAGMENT_FILES="$(BR2_EXTERNAL_GOYAOS_V2_PATH)/board/t110/kernel.fragment"
BR2_LINUX_KERNEL_ZIMAGE=y
BR2_PACKAGE_DROPBEAR=y
# BR2_PACKAGE_DROPBEAR_CLIENT is not set
BR2_PACKAGE_DROPBEAR_DISABLE_REVERSEDNS=y
BR2_PACKAGE_HOST_MKPASSWD=y
BR2_PACKAGE_LVGL=y
BR2_PACKAGE_GOYA_SHELL=y
```

## buildroot/goyaos-v2-external/package/goya-shell/Config.in
```kconfig
config BR2_PACKAGE_GOYA_SHELL
	bool "GoyaOS V2 desktop shell"
	depends on BR2_PACKAGE_LVGL
	help
	  Small single-process touchscreen desktop shell for the SM-T110.
	  It owns /dev/fb0 through the LVGL fbdev backend and uses the BT532
	  touchscreen through evdev.
```

## buildroot/goyaos-v2-external/package/lvgl/Config.in
```kconfig
config BR2_PACKAGE_LVGL
	bool "LVGL 9.6.0 graphics library"
	help
	  Lightweight C graphics library used by the GoyaOS V2 desktop shell.
	  The package is built as a static library with only fbdev and evdev
	  backends enabled; demos, examples and ThorVG are disabled.
```
